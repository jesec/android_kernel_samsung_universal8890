## arch/arm64/configs/exynos8890-herolte_defconfig
```kconfig
CONFIG_WLAN_HERO=y
# CONFIG_WLAN_HERO2 is not set
# CONFIG_EXYNOS_DECON_LCD_MCD is not set
CONFIG_LCD_ESD_IDLE_MODE=y
# CONFIG_PANEL_S6E3HF4_WQHD is not set
CONFIG_PANEL_S6E3HA3_DYNAMIC=y
CONFIG_SENSORS_HERO2 is not set
```

## drivers/media/platform/exynos/Kconfig
```kconfig
#
# Exynos multimedia device drivers
#
config VIDEO_EXYNOS
        bool "Exynos Multimedia Devices"
        depends on ARCH_EXYNOS8
        default y
        help
          This is a representative exynos multimedia device.

if VIDEO_EXYNOS
        source "drivers/media/platform/exynos/mdev/Kconfig"
endif

config MEDIA_EXYNOS
        bool
        help
          Compile mdev to use exynos media device driver.
```

## drivers/soc/samsung/Kconfig
```kconfig
#
# EXYNOS Soc drivers
#
menuconfig SOC_SAMSUNG
	bool "SAMSUNG SOC drivers support"

if SOC_SAMSUNG
config EXYNOS_CHIPID
	bool "Exynos Chip ID Driver Support"
	depends on ARCH_EXYNOS
	select SOC_BUS

config EXYNOS_REBOOT
	bool "Exynos Chip Reboot Driver Support"
	depends on ARCH_EXYNOS

config SAMSUNG_DMADEV
	bool
	select ARM_AMBA
	select DMADEVICES
	select PL330_DMA if (ARCH_EXYNOS8)
	help
	  Use DMA device engine for PL330 DMAC.

config ECT
	bool "Enable Exynos Characteristic Table File"
	default n
	depends on ARCH_EXYNOS

config ECT_DUMP
	bool "Enable Exynos Characteristic Table File Dump sysfs"
	default n
	depends on ECT

config EXYNOS_HOTPLUG_GOVERNOR
	bool "Enable Exynos dynamic hotplug governor"

config SCHED_HP_EVENT
	bool "Gathers scheduler events to decide hotplug in/out"
	depends on EXYNOS_HOTPLUG_GOVERNOR
	default y

config HP_EVENT_THREAD_GROUP
	bool "Gathres thread group information"
	depends on SCHED_HP_EVENT && SCHED_HMP
	default y

config HP_EVENT_BIG_THREADS
	bool "Gathres big threads in system"
	depends on SCHED_HP_EVENT && SCHED_HMP
	default n

endif #SOC_SAMSUNG
```
